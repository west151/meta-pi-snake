## conf/layer.conf
```bitbake
# We have a conf and classes directory, append to BBPATH
BBPATH .= ":${LAYERDIR}"

# We have a recipes directory, add to BBFILES
BBFILES += "${LAYERDIR}/recipes*/*/*.bb \
            ${LAYERDIR}/recipes*/*/*.bbappend \
            ${LAYERDIR}/images/*.bb"

BBFILE_COLLECTIONS += "meta-snake"
BBFILE_PATTERN_meta-snake := "^${LAYERDIR}/"
BBFILE_PRIORITY_meta-snake = "16"

LAYERSERIES_COMPAT_meta-snake = "thud"
```
